## meta-naos-package/conf/layer.conf
```bitbake
BBPATH .= ":${LAYERDIR}"
BBFILES += "${LAYERDIR}/recipes-*/*/*.bb ${LAYERDIR}/recipes-*/*/*.bbappend"
BBFILE_COLLECTIONS += "naos-package"
BBFILE_PATTERN_naos-package = "^${LAYERDIR}/"
BBFILE_PRIORITY_naos-package = "30"
LAYERSERIES_COMPAT_naos-package = "wrynose"
LAYERDEPENDS_naos-package = "core naos naos-rockchip naos-security"

NAOS_PACKAGE_LAYER_DIR := "${LAYERDIR}"
NAOS_PACKAGE_PROVIDER = "naos-generator-inputs-v1"
addpylib ${LAYERDIR}/lib naos_package
```

## meta-naos-qcom/conf/layer.conf
```bitbake
BBPATH .= ":${LAYERDIR}"
NAOS_QCOM_LAYER_DIR := "${LAYERDIR}"
BBFILES += "${LAYERDIR}/recipes-*/*/*.bb ${LAYERDIR}/recipes-*/*/*.bbappend"

BBFILE_COLLECTIONS += "naos-qcom"
BBFILE_PATTERN_naos-qcom = "^${LAYERDIR}/"
BBFILE_PRIORITY_naos-qcom = "10"
LAYERSERIES_COMPAT_naos-qcom = "wrynose"
LAYERDEPENDS_naos-qcom = "core meta-python naos qcom"
```

## meta-naos-qcom/conf/machine/include/naos-qcs9075.inc
```bitbake
require conf/machine/include/qcom-qcs9100.inc

MACHINEOVERRIDES =. "naos-qcs9075:"

QCOM_BOOT_FILES_SUBDIR = "qcs9100"
QCOM_BOOT_FIRMWARE = "firmware-qcom-boot-qcs9100"
```

## meta-naos-qcom/conf/machine/radxa-airbox-q900.conf
```bitbake
#@TYPE: Machine
#@NAME: Radxa AIRbox Q900
#@DESCRIPTION: NAOS for the QCS9075-based AIRbox Q900

require conf/machine/include/naos-qcs9075.inc

MACHINE_FEATURES += "efi kvm m2connector pci tpm2 phone"

QCOM_DTB_DEFAULT = "lemans-radxa-airbox-q900"
QCOM_UKI_DEVICETREE = "qcom/${QCOM_DTB_DEFAULT}.dtb"
KERNEL_DEVICETREE = "${QCOM_UKI_DEVICETREE}"
KERNEL_DTC_FLAGS:append = " -@"

QCOM_PARTITION_FILES_SUBDIR = "partitions/radxa-airbox-q900/ufs"
QCOM_CDT_FIRMWARE = "firmware-qcom-cdt-radxa-airbox-q900"
QCOM_CDT_FILE = "cdt_radxa_airbox_q900"

NAOS_Q900_XBL_CONFIG = "xbl_config_gunyah.elf"
NAOS_Q900_SIGNED_XBL_CONFIG = "xbl_config_gunyah-naos-signed.elf"
NAOS_Q900_SIGN_XBL_CONFIG ?= "0"
QCOM_XBL_CONFIG = "${NAOS_Q900_XBL_CONFIG}"

NAOS_Q900_SYSTEM_A_PARTUUID = "099c6bce-062a-543d-a895-bb1db785b1fe"
NAOS_Q900_SYSTEM_B_PARTUUID = "3d24017a-fdee-5d2a-9ed4-74123b3a179e"
NAOS_LAYOUT_COMPATIBLE = "naos-radxa-airbox-q900-ufs-v3${@'-disk-crypt' if d.getVar('NAOS_SYSTEM_ENCRYPTION') == '1' else '-data-crypt' if d.getVar('NAOS_DATA_ENCRYPTION') == '1' else ''}"

NAOS_SECURE_BOOT ?= "0"
NAOS_SECURE_BOOT_PROVIDER = "q900-uefi"
NAOS_SECURE_BOOT_KEY_DIR ?= "${NAOS_PROJECT_ROOT}/key/qcom-uefi-secure-boot"
NAOS_Q900_UEFI_AUTO_ENROLL ?= "0"
HOSTTOOLS_NONFATAL += "${@bb.utils.contains('NAOS_SECURE_BOOT', '1', 'sbsign sbverify', '', d)}"

NAOS_DISK_ENCRYPTION ?= "0"
NAOS_SYSTEM_ENCRYPTION ?= "${NAOS_DISK_ENCRYPTION}"
NAOS_DATA_ENCRYPTION ?= "${NAOS_DISK_ENCRYPTION}"
NAOS_SYSTEM_ENCRYPTION_PROVIDER = "qcs9075-hwkm"
NAOS_DATA_ENCRYPTION_PROVIDER = "qcs9075-hwkm"
NAOS_SYSTEM_KEY_DIR ?= "${NAOS_PROJECT_ROOT}/key/system-encryption"
INHERIT += "naos-disk-policy"
```

## meta-naos-rockchip/conf/layer.conf
```bitbake
BBPATH .= ":${LAYERDIR}"
BBFILES += "${LAYERDIR}/recipes-*/*/*.bb ${LAYERDIR}/recipes-*/*/*.bbappend"
BBFILE_COLLECTIONS += "naos-rockchip"
BBFILE_PATTERN_naos-rockchip = "^${LAYERDIR}/"
BBFILE_PRIORITY_naos-rockchip = "10"
LAYERSERIES_COMPAT_naos-rockchip = "wrynose"
LAYERDEPENDS_naos-rockchip = "core naos"
NAOS_ROCKCHIP_LAYER_DIR := "${LAYERDIR}"
NAOS_LAYOUT_FILE ?= "${NAOS_ROCKCHIP_LAYER_DIR}/recipes-core/images/files/${MACHINE}.json"
LICENSE_PATH:append := " ${LAYERDIR}/licenses"
NAOS_SBOM_COMPONENT_EXTENSION = "naos_rockchip.sbom:extend_component"
NAOS_SBOM_EXTENSION_DIR := "${LAYERDIR}/lib/naos_rockchip"
addpylib ${LAYERDIR}/lib naos_rockchip
```

## meta-naos-security/conf/layer.conf
```bitbake
BBPATH .= ":${LAYERDIR}"
BBFILES += "${LAYERDIR}/recipes-*/*/*.bb ${LAYERDIR}/recipes-*/*/*.bbappend"
BBFILE_COLLECTIONS += "naos-security"
BBFILE_PATTERN_naos-security = "^${LAYERDIR}/"
BBFILE_PRIORITY_naos-security = "20"
LAYERSERIES_COMPAT_naos-security = "wrynose"
LAYERDEPENDS_naos-security = "core naos naos-rockchip"

NAOS_SECURE_BOOT_PROVIDER = "rk3588-fit"
NAOS_DATA_ENCRYPTION_PROVIDER = "rk3588-tee-trusted"
NAOS_SYSTEM_ENCRYPTION_PROVIDER = "rk3588-huk"
NAOS_SYSTEM_KEY_DIR ?= "${NAOS_PROJECT_ROOT}/key/system-encryption"
NAOS_RK_TEE_USER_URI ?= "git://github.com/mixtile-rockchip/mixtile-sdk-android-rk-platform-system-rk_tee_user.git;protocol=https;branch=rk3588-linux-6.12-stan-rkr1"
NAOS_SECURE_BOOT_KEY_DIR ?= "${NAOS_PROJECT_ROOT}/key/secure-boot"
NAOS_SECURE_BOOT_BURN_KEY_HASH ?= "0"
INHERIT += "naos-secure-boot"
```

## meta-naos/conf/distro/include/naos-security-tool.inc
```bitbake
NAOS_SECURITY_TOOL_URI ?= "git://github.com/mixtile-rockchip/security-tool.git;protocol=https;branch=main"
NAOS_SECURITY_TOOL_SRCREV ?= "1b952ed80bf681b03bdfdaf047228fdb4b1c09ab"
```
